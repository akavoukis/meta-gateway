## conf/layer.conf
```bitbake
# We have a conf and classes directory, add to BBPATH
BBPATH .= ":${LAYERDIR}"

LAYERSERIES_COMPAT_meta-gateway = "sumo"

# We have recipes-* directories, add to BBFILES
BBFILES += "${LAYERDIR}/recipes-*/*/*.bb \
	${LAYERDIR}/recipes-*/*/*.bbappend"

BBFILE_COLLECTIONS += "meta-gateway"
BBFILE_PATTERN_meta-gateway = "^${LAYERDIR}/"
BBFILE_PRIORITY_meta-gateway = "6"
```
